/*
 * Minimal overlay for TOTEM dongle shield.
 * Reuse the TOTEM shield's matrix/kscan so the build has valid
 * transform definitions, while setting split role to central.
 */

#include "../totem/totem.dtsi"

/ {
    chosen {
        // Ensure role is central at the DTS level for clarity (redundant with Kconfig)
        zmk,split-role = "central";
    };
};



